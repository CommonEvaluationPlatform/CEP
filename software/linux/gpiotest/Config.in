## software/linux/gpiotest/Config.in
```kconfig
#***********************************************************************
# Copyright 2024 Massachusetts Institute of Technology
# SPDX short identifier: BSD-3-Clause
#
# File Name:      Config.in
# Program:        Common Evaluation Platform (CEP)
# Description:    Buildroot configuration file for CEP linux application
# Notes:          
#************************************************************************

config BR2_PACKAGE_GPIOTEST
	bool "gpiotest"
	depends on BR2_PACKAGE_LIBGPIOD
	help
	  A linux port of the baremetal gpiotest program
```

## software/linux/helloworld/Config.in
```kconfig
#***********************************************************************
# Copyright 2024 Massachusetts Institute of Technology
# SPDX short identifier: BSD-3-Clause
#
# File Name:      Config.in
# Program:        Common Evaluation Platform (CEP)
# Description:    Buildroot configuration file for CEP linux application
# Notes:          
#************************************************************************

config BR2_PACKAGE_HELLOWORLD
	bool "helloworld"
	help
	  A simple hello world program
```

## software/linux/helloworld/Config.in.host
```kconfig
config BR2_PACKAGE_HOST_HELLOWORLD
	bool "host helloworld"
	help
	  A simple hello world program
```
